## local-modules/modu-dongle/Kconfig
```kconfig
# SPDX-License-Identifier: MIT
menu "MODU-C dongle status additions"
config MODU_PERIPHERAL_STATUS_LED
    bool "Show the actual keyboard-to-dongle BLE link on the keyboard LED"
    depends on ZMK_SPLIT && !ZMK_SPLIT_ROLE_CENTRAL && ZMK_SPLIT_BLE && PWM
    default n

config MODU_STATUS_LED_BRIGHTNESS
    int "Connected/disconnected status LED brightness (percent)"
    depends on MODU_PERIPHERAL_STATUS_LED
    range 1 100
    default 12

config MODU_DONGLE_STATUS_SCREEN
    bool "Original Corne dongle display with Mac modifier symbols"
    depends on ZMK_DISPLAY && ZMK_SPLIT_ROLE_CENTRAL && ZMK_SPLIT_BLE
    depends on ZMK_SPLIT_BLE_CENTRAL_BATTERY_LEVEL_FETCHING
    select LV_USE_LABEL
    select LV_USE_IMAGE
    select LV_USE_CANVAS
    select LV_USE_ANIMIMG
    select LV_USE_ANIMATION
    select LV_USE_LINE
    select LV_FONT_UNSCII_8
    select ZMK_WPM
    default n

if MODU_DONGLE_STATUS_SCREEN

# Same UI options as englmaxi/zmk-dongle-display. Its Kconfig declarations are
# normally gated by SHIELD_DONGLE_DISPLAY; we compile its widgets in our shield
# to apply narrow compatibility fixes without modifying the fetched project.
config ZMK_DONGLE_DISPLAY_MAC_MODIFIERS
    bool "Use Control / Option / Command / Shift symbols"
    default y
config ZMK_DONGLE_DISPLAY_DONGLE_BATTERY
    bool "Include dongle battery row"
    default y
config ZMK_DONGLE_DISPLAY_MODIFIERS
    bool "Display active modifier symbols"
    default y
config ZMK_DONGLE_DISPLAY_BONGO_CAT
    bool "Keep original Bongo Cat widget"
    default y
config ZMK_DONGLE_DISPLAY_LAYER
    bool "Display current layer"
    default y
config ZMK_DONGLE_DISPLAY_LAYER_NAME_SCROLL_WIDTH
    int "Layer name width"
    default 50
config ZMK_DONGLE_DISPLAY_LAYER_TEXT_ALIGN
    string "Layer name alignment"
    default "left"
config ZMK_DONGLE_DISPLAY_WPM
    bool "Show WPM counter (original default is off)"
    default n
config ZMK_DONGLE_DISPLAY_WPM_DISABLED_LAYERS
    string "WPM excluded layers"
    default ""

config MODU_DONGLE_HAS_BATTERY
    bool "Read dongle battery sensor for D row"
    depends on ZMK_BATTERY_REPORTING && ZMK_DONGLE_DISPLAY_DONGLE_BATTERY
    default y
    help
      Uses the board's zmk,battery sensor, not a fabricated percentage.
      Only meaningful if a real battery is connected to a valid measurement
      circuit. For a USB-only dongle set this to n; D then reads USB or EXT.
endif
config MODU_BATTERY_TELEMETRY_PERIPHERAL
    bool "Report measured voltage, sensor status and hand identity to the dongle"
    depends on ZMK_SPLIT && !ZMK_SPLIT_ROLE_CENTRAL && ZMK_BLE
    depends on ZMK_BATTERY_REPORTING && SENSOR
    default n
    help
      A read-only encrypted BLE diagnostic service. Preserves the original
      battery sensor pins, voltage-divider ratio and normal BAS reporting.

config MODU_BATTERY_TELEMETRY_CENTRAL
    bool "Read both keyboard sensor results, including voltage and errors"
    depends on ZMK_SPLIT && ZMK_SPLIT_ROLE_CENTRAL && ZMK_BLE
    select BT_GATT_CLIENT
    default n
    help
      Periodically polls the read-only diagnostic characteristic on each
      existing split link. Does not connect to additional devices.
config MODU_BATTERY_ACTIVE_INTERVAL
    int "Active keyboard diagnostic sample interval in seconds"
    depends on MODU_BATTERY_TELEMETRY_PERIPHERAL
    range 30 120
    default 60

config MODU_BATTERY_IDLE_INTERVAL
    int "Idle keyboard diagnostic sample interval in seconds"
    depends on MODU_BATTERY_TELEMETRY_PERIPHERAL
    range 180 600
    default 300
    help
      Keep a sparse measurement while idle, including during charging.
      GATT reads return cached samples and do not force idle ADC sampling.

config MODU_BATTERY_RANGE_DISPLAY
    bool "Display empirical MODU-C L/R battery gauge"
    depends on MODU_DONGLE_STATUS_SCREEN && MODU_BATTERY_TELEMETRY_CENTRAL
    default n
    help
      Display-only empirical gauge based on observed MODU-C wireless-use readings.
      USB-powered halves show CHG and are excluded from discharge percentage.
      Does not change ADC readings, sensor conversion, BAS, pairing or charging.
      This is a practical relative gauge, not laboratory state-of-charge.

if MODU_BATTERY_RANGE_DISPLAY
config MODU_BATTERY_RANGE_LEFT_MIN_MV
    int "Left empirical near-shutdown reading (mV)"
    range 1000 4499
    default 1750
config MODU_BATTERY_RANGE_LEFT_MAX_MV
    int "Left empirical unplugged-full reading (mV)"
    range 1001 4500
    default 2950
config MODU_BATTERY_RANGE_RIGHT_MIN_MV
    int "Right empirical near-shutdown reading (mV)"
    range 1000 4499
    default 1750
config MODU_BATTERY_RANGE_RIGHT_MAX_MV
    int "Right empirical unplugged-full reading (mV)"
    range 1001 4500
    default 2950
endif

config MODU_UNIVERSAL_DEEP_SLEEP
    bool "Allow keyboard halves to enter System OFF even while USB/VBUS is present"
    depends on ZMK_SPLIT && !ZMK_SPLIT_ROLE_CENTRAL && ZMK_SLEEP
    default n
    help
      ZMK normally suppresses automatic deep sleep while USB power is detected.
      MODU-C halves are BLE peripherals, so this option adds a second inactivity
      guard that enters the same device-suspend + System OFF path regardless of
      USB/VBUS presence. This does not change charger current or charging IC logic.

if MODU_UNIVERSAL_DEEP_SLEEP
config MODU_UNIVERSAL_DEEP_SLEEP_TIMEOUT_MS
    int "Total inactivity before universal System OFF (milliseconds)"
    range 60000 1800000
    default 120000
    help
      Total inactivity from the last key/pointing activity. The implementation
      waits for normal ZMK Idle first, then sleeps after the remaining interval.
      With ZMK_IDLE_TIMEOUT=30000 and this value=120000, System OFF occurs at
      about two minutes of inactivity whether charging or running on battery.
endif
endmenu
```

## local-modules/modu-dongle/boards/shields/modu_dongle/Kconfig.defconfig
```kconfig
# Unofficial MODU-C dongle adaptation; see LICENSE.
if SHIELD_MODU_DONGLE || SHIELD_MODU_PERIPHERAL_LEFT || SHIELD_MODU_PERIPHERAL_RIGHT
config ZMK_SPLIT
    default y
endif

if SHIELD_MODU_DONGLE
config ZMK_KEYBOARD_NAME
    default "Modu Dongle"
config ZMK_SPLIT_ROLE_CENTRAL
    default y
config ZMK_SPLIT_BLE_CENTRAL_PERIPHERALS
    default 2
config BT_MAX_CONN
    default 7
config BT_MAX_PAIRED
    default 7
endif

if SHIELD_MODU_PERIPHERAL_LEFT || SHIELD_MODU_PERIPHERAL_RIGHT
config ZMK_SPLIT_ROLE_CENTRAL
    default n
endif
```

## local-modules/obrey-combo-boot/Kconfig
```kconfig
# SPDX-License-Identifier: MIT
config ZMK_BEHAVIOR_OBREY_COMBO_BOOT
    bool
    default y
    depends on DT_HAS_ZMK_BEHAVIOR_OBREY_COMBO_BOOT_ENABLED
    depends on ZMK_SPLIT && ZMK_SPLIT_ROLE_CENTRAL
    help
      Restore the actual physical source when a direct three-key combo invokes
      the standard source-specific bootloader behavior. No new transport.
```

## local-modules/obrey-combo-boot/dts/bindings/behaviors/zmk,behavior-obrey-combo-boot.yaml
```yaml
# SPDX-License-Identifier: MIT
description: Boot the actual source of a recognized three-key combo
compatible: "zmk,behavior-obrey-combo-boot"
include: zero_param.yaml
properties:
  bindings:
    type: phandle-array
    required: true
    description: One parameterless standard bootloader binding
  key-positions:
    type: array
    required: true
    description: The same three physical positions as the invoking combo
  window-ms:
    type: int
    default: 80
    description: Maximum skew between the three physical presses
```

## vendor/modu-c-firmware/modu-module/boards/minewsemi/ms88sf3/board.yml
```yaml
board:
  name: ms88sf3
  full_name: Minewsemi MS88SF3
  vendor: minewsemi
  socs:
    - name: nrf52840
```

## vendor/modu-c-firmware/modu-module/boards/shields/modu/Kconfig.defconfig
```kconfig
# Copyright (c) 2026 EKS Inc.
# Created by Ryu.
# SPDX-License-Identifier: LicenseRef-EKS-NonCommercial-1.0

if SHIELD_MODU_LEFT

config ZMK_KEYBOARD_NAME
    default "Modu"

config ZMK_SPLIT_ROLE_CENTRAL
    default y

endif

if SHIELD_MODU_LEFT || SHIELD_MODU_RIGHT

config ZMK_SPLIT
    default y

endif
```

## vendor/modu-c-firmware/modu-module/boards/shields/modu/Kconfig.shield
```kconfig
# Copyright (c) 2026 EKS Inc.
# Created by Ryu.
# SPDX-License-Identifier: LicenseRef-EKS-NonCommercial-1.0

config SHIELD_MODU_LEFT
    def_bool $(shields_list_contains,modu_left)

config SHIELD_MODU_RIGHT
    def_bool $(shields_list_contains,modu_right)
```

## vendor/modu-c-firmware/modu-module/dts/bindings/kscan/modu,kscan-alt-thumb-remap.yaml
```yaml
description: MODU boot-time alt thumb kscan remapper

compatible: "modu,kscan-alt-thumb-remap"

include: kscan.yaml

properties:
  kscan:
    type: phandle
    required: true
  orientation-gpios:
    type: phandle-array
    required: true
```

## vendor/modu-c-firmware/modu-module/src/alt_thumb_kscan/Kconfig
```kconfig
config MODU_ALT_THUMB_KSCAN
    bool "MODU boot-time alt thumb kscan remap"
    help
      Remap the thumb cluster at the kscan stage when P0.08 is grounded at boot.

config MODU_ALT_THUMB_KSCAN_INIT_PRIORITY
    int "MODU alt thumb kscan init priority"
    default 96
    depends on MODU_ALT_THUMB_KSCAN
    help
      Must run after zmk,kscan-composite, which defaults to priority 95 here.
```

## vendor/modu-c-firmware/modu-module/src/led_breath/Kconfig
```kconfig
config MODU_LED_BREATH
    bool "Modu LED breathing effect"
    default y
    depends on PWM
    help
      Enable breathing effect for status LEDs using PWM.

config MODU_LED_BREATH_PERIOD_MS
    int "Breathing cycle period in milliseconds"
    default 3000
    depends on MODU_LED_BREATH
    help
      Duration of one full breath cycle (fade in + fade out).

config MODU_LED_BREATH_STEP_MS
    int "Breathing update interval in milliseconds"
    default 20
    depends on MODU_LED_BREATH
    help
      How often the PWM duty cycle is updated during breathing.
```

## vendor/modu-c-firmware/zmk-pmw3610-driver/dts/bindings/pixart,pmw3610-alt.yml
```yaml
description: |
  Sensor driver for the pixart PMW3610 mouse sensor 

compatible: "pixart,pmw3610-alt"

include: spi-device.yaml

properties:
  irq-gpios:
    type: phandle-array
    required: true
  cpi:
    type: int
    default: 600
    description: "CPI value (Range: 200 - 3200, Step: 200)"
  swap-xy:
    type: boolean
  invert-x:
    type: boolean
  invert-y:
    type: boolean
  rotation-cos-milli:
    type: int
    default: 1000
    description: "Rotation matrix cosine value scaled by 1000. Default 1000 means no rotation."
  rotation-sin-milli:
    type: int
    default: 0
    description: "Rotation matrix sine value scaled by 1000. Default 0 means no rotation."
  orientation-gpios:
    type: phandle-array
    description: "Optional boot-time orientation select pin. Active means use alternate rotation."
  alt-rotation-cos-milli:
    type: int
    default: 1000
    description: "Alternate rotation matrix cosine value scaled by 1000."
  alt-rotation-sin-milli:
    type: int
    default: 0
    description: "Alternate rotation matrix sine value scaled by 1000."
  alt-swap-xy:
    type: boolean
    description: "Use XY swap when the orientation select pin is active."
  alt-invert-x:
    type: boolean
    description: "Invert X when the orientation select pin is active."
  alt-invert-y:
    type: boolean
    description: "Invert Y when the orientation select pin is active."

  evt-type:
    type: int
    required: true
  x-input-code:
    type: int
    required: true
  y-input-code:
    type: int
    required: true
  force-awake:
    type: boolean
  force-awake-4ms-mode:
    type: boolean
```
