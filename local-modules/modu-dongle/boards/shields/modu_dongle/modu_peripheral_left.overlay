/*
 * Copyright (c) 2026 EKS Inc. Created by Ryu.
 * SPDX-License-Identifier: LicenseRef-EKS-NonCommercial-1.0
 * Unofficial Obrey dongle adaptation; see root NOTICE.md.
 */

/* Reuse the uploaded hardware file: same pins, orientation and sensor driver.
 * The include is local and versioned; no extra MODU repository is downloaded.
 */
#include "../../../../../vendor/modu-c-firmware/modu-module/boards/shields/modu/modu_left.overlay"
#include "modu-inputs.dtsi"

/* Old two-device routing must NOT remain active in the three-device layout. */
&trackball_listener { status = "disabled"; };
&peripheral_trackball_listener { status = "disabled"; };
&trackball_split { status = "disabled"; };

/* Sensor already applies its original inversion/orientation; do not do it twice. */
&modu_left_split {
    status = "okay";
    device = <&trackball>;
};
